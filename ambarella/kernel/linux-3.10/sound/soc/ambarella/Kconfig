## ambarella/kernel/linux-3.10/sound/soc/ambarella/Kconfig
```kconfig
config SND_AMBARELLA_SOC
	tristate "SoC Audio for the Ambarella chips"
	depends on PLAT_AMBARELLA && SND_SOC
	select SND_SOC_GENERIC_DMAENGINE_PCM
	help
	  Say Y or M if you want to add support for codecs attached to
	  the AMBARELLA I2S interface. You will also need
	  to select the audio interfaces to support below.

config SND_AMBARELLA_SOC_I2S
	tristate

menuconfig SND_AMBARELLA_BOARD
	tristate "Ambarella Board Type"
	depends on SND_AMBARELLA_SOC
	help
	  Say Y or M to select specific ambarella board.

if SND_AMBARELLA_BOARD

config AMBA_BOARD
	tristate "Ambarella General Board"
	depends on SND_AMBARELLA_SOC
	select SND_AMBARELLA_SOC_I2S
	select SND_SOC_AMBARELLA_DUMMY
	help
	  Say Y if you want to use ALSA driver on Ambarella General Board.

endif

menuconfig SND_AMBARELLA_CODEC
	tristate "Select Codec for Ambarella Platform"
	depends on SND_AMBARELLA_SOC
	help
	  Say Y or M to select specific Codec for Ambarella Platform.

if SND_AMBARELLA_CODEC

config SND_SOC_AK4642_AMB
	tristate "AK4642 for Ambarella"
	help
		Support AK4642 for A5S/S2_EVK/S2E_GINKGO/Hawthorn/s2lsmallbin.

config SND_SOC_AK4951_AMB
	tristate "AK4951 for Ambarella"
	help
		Support AK4951 for Ambarella S2E_EVK/S2lm_kiwi/s2lm_ironman.

config SND_SOC_AK4954_AMB
	tristate "AK4954 for Ambarella"
	help
		Support AK4951 for Ambarella s2lm_kiwi/s2lm_ironman.

config SND_SOC_AK7719_DSP
	tristate "AK7719_DSP for Ambarella"
	depends on SND_AMBARELLA_SOC && (SND_SOC_AK4954_AMB || SND_SOC_AK4951_AMB)
	help
	  Say Y if you want to add AK7719 DSP support for
	  SoC audio on Ambarella Board.
	  and the AK7719_DSP should be modprobed before AK4954/AK4951.

config SND_SOC_ES8388
	tristate "ES8388 for Ambarella"
	help
		Support ES8388 for s2lm_iceman.

config SND_SOC_WM8974_AMB
	tristate "WM8974 for Ambarella"
	help
		Support WM8974 for s2lm_elektra.

config SND_SOC_WM8940_AMB
	tristate "WM8940 for Ambarella"
	help
		Support WM8940 for strawnerry

config SND_SOC_AMBARELLA_DUMMY
	tristate "Dummy Codec for Ambarella"
	help
		Support Dummy Codec for Ambarella

endif
```
